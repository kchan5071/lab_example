## meta-lab/conf/distro/lab-distro.conf
```bitbake
require conf/distro/poky.conf

DISTRO = "lab-distro"
DISTRO_NAME = "Lab-MicroZed"
```

## meta-lab/conf/machine/lab-microzed.conf
```bitbake
XILINX_WITH_ESW = "xsct"
XILINX_XSCT_VERSION = "2024.2"
HDF_URI = "file:///work/project/artifacts/microzed/reference/system.xsa"
HDF_URI[sha256sum] = "217a689ebeda517d912af54efa9646f8c21f16a272a0e38b055b8c1c0a7185c5"

require conf/machine/zynq-generic.conf

FSBL_IMAGE_NAME = "fsbl-${MACHINE}"
FSBL_FILE = "${DEPLOY_DIR_IMAGE}/${FSBL_IMAGE_NAME}"
FSBL_DEPENDS = "fsbl-firmware:do_deploy"
```

## meta-lab/wic/lab-sd.wks
```
part /boot --source bootimg-partition --ondisk mmcblk0 --fstype=vfat --label boot --active --align 4096 --fixed-size 256
part / --source rootfs --ondisk mmcblk0 --fstype=ext4 --label rootfs --align 4096
bootloader --ptable msdos
```
